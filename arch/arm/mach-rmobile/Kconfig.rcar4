## arch/arm/mach-rmobile/Kconfig.rcar4
```kconfig
if RCAR_GEN4

menu "Select Target SoC"

config R8A779A0
	bool "Renesas SoC R8A779A0"
	select GICV3
	imply CLK_R8A779A0
	imply PINCTRL_PFC_R8A779A0

config R8A779F0
	bool "Renesas SoC R8A779F0"
	select GICV3 if !RCAR_XEN
	imply CLK_R8A779F0
	imply PINCTRL_PFC_R8A779F0

config R8A779G0
	bool "Renesas SoC R8A779G0"
	select GICV3
	imply CLK_R8A779G0
	imply PINCTRL_PFC_R8A779G0

endmenu

choice
	prompt "Renesas ARM64 SoCs board select"
	optional

config TARGET_FALCON
	bool "Falcon board"
	imply R8A779A0
	help
          Support for Renesas R-Car Gen3 Falcon platform

config TARGET_SPIDER
	bool "Spider board"
	imply R8A779F0
	help
	  Support for Renesas R-Car Gen4 Spider platform

config TARGET_WHITEHAWK
	bool "White Hawk board"
	imply R8A779G0
	help
	  Support for Renesas R-Car Gen4 White Hawk platform

config TARGET_RCAR4_XEN
	bool "Gen4 boards for Xen DomD"
	select RCAR_XEN
	select LINUX_KERNEL_IMAGE_HEADER
	imply R8A779F0
	imply SYS_MALLOC_F
	help
          Support for Renesas R-Car Gen4 platform for Xen DomD

endchoice

source "board/renesas/falcon/Kconfig"
source "board/renesas/spider/Kconfig"
source "board/renesas/whitehawk/Kconfig"
source "board/renesas/rcar4-xen/Kconfig"

endif
```

## board/renesas/rcar3-xen/Kconfig
```kconfig
if TARGET_RCAR3_XEN

config SYS_SOC
	default "rmobile"

config SYS_BOARD
	default "rcar3-xen"

config SYS_VENDOR
	default "renesas"

config SYS_CONFIG_NAME
	default "rcar3-xen"

endif
```

## board/renesas/rcar4-xen/Kconfig
```kconfig
if TARGET_RCAR4_XEN

config SYS_SOC
	default "rmobile"

config SYS_BOARD
	default "rcar4-xen"

config SYS_VENDOR
	default "renesas"

config SYS_CONFIG_NAME
	default "rcar4-xen"

endif
```

## configs/rcar3_salvator-x-xen_defconfig
```kconfig
CONFIG_ARM=y
CONFIG_ARCH_CPU_INIT=y
CONFIG_ARCH_RMOBILE=y
CONFIG_SYS_TEXT_BASE=0x40080000
CONFIG_ENV_SIZE=0x1000
CONFIG_DM_GPIO=y
CONFIG_RCAR_GEN3=y
CONFIG_TARGET_SALVATOR_X_XEN=y
# CONFIG_SPL is not set
CONFIG_DEFAULT_DEVICE_TREE="r8a77951-salvator-x-xen-u-boot"
CONFIG_SMBIOS_PRODUCT_NAME=""
CONFIG_XEN=y
CONFIG_USE_BOOTARGS=y
CONFIG_BOOTARGS="root=/dev/nfs rw nfsroot=192.168.0.1:/export/rfs ip=192.168.0.20"
CONFIG_SUPPORT_RAW_INITRD=y
CONFIG_DEFAULT_FDT_FILE="r8a77951-salvator-x-xen.dtb"
CONFIG_VERSION_VARIABLE=y
CONFIG_BOUNCE_BUFFER=y
CONFIG_HUSH_PARSER=y
CONFIG_CMD_BOOTZ=y
CONFIG_CMD_GPIO=y
CONFIG_CMD_I2C=y
CONFIG_CMD_MMC=y
CONFIG_CMD_PCI=y
CONFIG_CMD_USB=y
CONFIG_CMD_DHCP=y
CONFIG_CMD_MII=y
CONFIG_CMD_PING=y
CONFIG_CMD_EXT2=y
CONFIG_CMD_EXT4=y
CONFIG_CMD_EXT4_WRITE=y
CONFIG_CMD_FAT=y
CONFIG_CMD_FS_GENERIC=y
CONFIG_OF_CONTROL=y
CONFIG_OF_BOARD=y
# CONFIG_MULTI_DTB_FIT is not set
CONFIG_ENV_OVERWRITE=y
CONFIG_ENV_IS_NOWHERE=y
CONFIG_SYS_RELOC_GD_ENV_ADDR=y
CONFIG_REGMAP=y
CONFIG_SYSCON=y
CONFIG_BLK=y
CONFIG_CLK=y
CONFIG_CLK_RENESAS=y
CONFIG_CLK_RCAR_GEN3=y
CONFIG_CLK_R8A7795=y
CONFIG_CLK_R8A7796=y
CONFIG_CLK_R8A77965=y
CONFIG_FIRMWARE=y
CONFIG_ARM_PSCI_FW=y
CONFIG_RCAR_GPIO=y
CONFIG_DM_I2C=y
CONFIG_SYS_I2C_RCAR_IIC=y
CONFIG_DM_MMC=y
CONFIG_MMC_IO_VOLTAGE=y
CONFIG_MMC_UHS_SUPPORT=y
CONFIG_MMC_HS400_SUPPORT=y
CONFIG_MMC_HS200_SUPPORT=y
CONFIG_MMC_VERBOSE=y
CONFIG_RENESAS_SDHI=y
CONFIG_BITBANGMII=y
CONFIG_PHY_MICREL=y
CONFIG_PHY_MICREL_KSZ90X1=y
CONFIG_DM_ETH=y
CONFIG_RENESAS_RAVB=y
CONFIG_PCI=y
CONFIG_DM_PCI=y
CONFIG_PCI_PNP=y
CONFIG_PCI_RCAR_GEN3=y
CONFIG_PHY=y
CONFIG_PHY_RCAR_GEN3=y
CONFIG_PINCTRL=y
CONFIG_PINCTRL_FULL=y
CONFIG_PINCTRL_GENERIC=y
CONFIG_PINMUX=y
CONFIG_PINCONF=y
CONFIG_PINCONF_RECURSIVE=y
CONFIG_PINCTRL_PFC=y
CONFIG_PINCTRL_PFC_R8A7795=y
CONFIG_PINCTRL_PFC_R8A7796=y
CONFIG_PINCTRL_PFC_R8A77965=y
CONFIG_DM_REGULATOR=y
CONFIG_DM_REGULATOR_COMMON=y
CONFIG_DM_REGULATOR_FIXED=y
CONFIG_DM_REGULATOR_GPIO=y
# CONFIG_REQUIRE_SERIAL_CONSOLE is not set
CONFIG_SPECIFY_CONSOLE_INDEX=y
CONFIG_SCIF_CONSOLE=y
CONFIG_USB=y
CONFIG_DM_USB=y
CONFIG_USB_HOST=y
CONFIG_USB_XHCI_HCD=y
CONFIG_USB_XHCI_RCAR=y
CONFIG_USB_EHCI_HCD=y
CONFIG_USB_EHCI_GENERIC=y
CONFIG_USB_STORAGE=y
CONFIG_FS_EXT4=y
CONFIG_EXT4_WRITE=y
CONFIG_FS_FAT=y
CONFIG_FAT_WRITE=y
CONFIG_FS_FAT_MAX_CLUSTSIZE=65536
CONFIG_LIB_UUID=y
CONFIG_PRINTF=y
CONFIG_SPL_PRINTF=y
CONFIG_SPRINTF=y
CONFIG_SPL_SPRINTF=y
CONFIG_STRTO=y
CONFIG_SPL_STRTO=y
CONFIG_IMAGE_SPARSE=y
CONFIG_IMAGE_SPARSE_FILLBUF_SIZE=0x80000
CONFIG_SYS_HZ=1000
CONFIG_SPL_USE_TINY_PRINTF=y
CONFIG_REGEX=y
CONFIG_LIB_RAND=y
CONFIG_SPL_TINY_MEMSET=y
CONFIG_SHA1=y
CONFIG_SHA256=y
CONFIG_MD5=y
CONFIG_LZ4=y
CONFIG_LZMA=y
CONFIG_LZO=y
CONFIG_GZIP=y
CONFIG_ZLIB=y
CONFIG_OF_LIBFDT=y
CONFIG_OF_LIBFDT_ASSUME_MASK=0
CONFIG_OF_LIBFDT_OVERLAY=y
CONFIG_SMBIOS_MANUFACTURER=""
CONFIG_CMD_PVBLOCK=y
CONFIG_MMC=y
CONFIG_DM_MMC=y
#CONFIG_SPL=y
#CONFIG_SPL_LIBCOMMON_SUPPORT=y
#CONFIG_SPL_BUILD=n
CONFIG_CMD_MMC=y
CONFIG_USB_UHCI=y
```

## configs/rcar3_xen_defconfig
```kconfig
CONFIG_ARM=y
CONFIG_ARCH_CPU_INIT=y
CONFIG_ARCH_RMOBILE=y
CONFIG_TEXT_BASE=0x40000000
CONFIG_SYS_MALLOC_LEN=0x100000
CONFIG_NR_DRAM_BANKS=1
CONFIG_ENV_SIZE=0x1000
CONFIG_DM_GPIO=y
CONFIG_DEFAULT_DEVICE_TREE="r8a77950-salvator-x-u-boot"
CONFIG_RCAR_GEN3=y
CONFIG_TARGET_RCAR3_XEN=y
# CONFIG_SPL is not set
CONFIG_CMO_BY_VA_ONLY=y
CONFIG_SYS_LOAD_ADDR=0x40000000
CONFIG_XEN=y
CONFIG_SYS_BOOT_GET_CMDLINE=y
CONFIG_SYS_BARGSIZE=1024
CONFIG_SUPPORT_RAW_INITRD=y
CONFIG_OF_SYSTEM_SETUP=y
CONFIG_USE_BOOTARGS=y
CONFIG_BOOTARGS="root=/dev/mmcblk1p4 ro rootwait console=hvc0 clk_ignore_unused pci=pcie_bus_perf vardir.disk=/dev/mmcblk1p5 opendisk.target=/dev/mmcblk1p6 opendisk.pkcs11=optee aosupdate.disk=/dev/aosvg/workdirs aosupdate.path=um/update_rootfs aosupdate.selinux_module=/usr/share/selinux/aos/base.pp"
CONFIG_USE_BOOTCOMMAND=y
CONFIG_BOOTCOMMAND="ext4load mmc 1:1 0x44001000 linux-domd; ext4load mmc 1:1 0x81000000 initramfs-domd; booti 0x44001000 0x81000000:0x${filesize} 0x48000000"
CONFIG_HUSH_PARSER=y
CONFIG_SYS_MAXARGS=64
CONFIG_CMD_BOOTZ=y
CONFIG_CMD_MMC=y
CONFIG_CMD_BKOPS_ENABLE=y
CONFIG_CMD_DHCP=y
CONFIG_CMD_MII=y
CONFIG_CMD_PING=y
CONFIG_CMD_EXT2=y
CONFIG_CMD_EXT4=y
CONFIG_CMD_EXT4_WRITE=y
CONFIG_CMD_FAT=y
CONFIG_CMD_FS_GENERIC=y
CONFIG_OF_CONTROL=y
CONFIG_OF_BOARD=y
CONFIG_ENV_OVERWRITE=y
CONFIG_SYS_RELOC_GD_ENV_ADDR=y
CONFIG_VERSION_VARIABLE=y
CONFIG_REGMAP=y
CONFIG_SYSCON=y
CONFIG_CLK=y
CONFIG_CLK_RENESAS=y
CONFIG_RCAR_GPIO=y
# CONFIG_SUPPORT_EMMC_RPMB is not set
CONFIG_MMC_IO_VOLTAGE=y
CONFIG_MMC_UHS_SUPPORT=y
CONFIG_MMC_HS400_SUPPORT=y
CONFIG_RENESAS_SDHI=y
CONFIG_BITBANGMII=y
CONFIG_BITBANGMII_MULTI=y
CONFIG_PHY_MICREL=y
CONFIG_PHY_MICREL_KSZ90X1=y
CONFIG_RENESAS_RAVB=y
CONFIG_DM_REGULATOR=y
CONFIG_DM_REGULATOR_FIXED=y
CONFIG_DM_REGULATOR_GPIO=y
# CONFIG_REQUIRE_SERIAL_CONSOLE is not set
CONFIG_SPECIFY_CONSOLE_INDEX=y
CONFIG_XEN_SERIAL=y
CONFIG_USB=y
CONFIG_USB_XHCI_HCD=y
CONFIG_USB_EHCI_HCD=y
CONFIG_USB_EHCI_GENERIC=y
CONFIG_USB_STORAGE=y
CONFIG_SHA1=y
CONFIG_SHA256=y
CONFIG_MD5=y
CONFIG_LZO=y
```
